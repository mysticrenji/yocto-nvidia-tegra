## build/conf/bblayers.conf
```bitbake
# POKY_BBLAYERS_CONF_VERSION is increased each time build/conf/bblayers.conf
# changes incompatibly
POKY_BBLAYERS_CONF_VERSION = "2"

BBPATH = "${TOPDIR}"
BBFILES ?= ""

BBLAYERS ?= " \
  /home/ubuntu/yocto-tegra/meta-tegra \
  /home/ubuntu/yocto-tegra/meta-openembedded/meta-oe \
  /home/ubuntu/yocto-tegra/meta-openembedded/meta-python \
  /home/ubuntu/yocto-tegra/meta-openembedded/meta-networking \
  /home/ubuntu/yocto-tegra/meta-openembedded/meta-filesystems \
  /home/ubuntu/yocto-tegra/meta-virtualization \
  /home/ubuntu/yocto-tegra/poky/meta \
  /home/ubuntu/yocto-tegra/poky/meta-poky \
  /home/ubuntu/yocto-tegra/poky/meta-yocto-bsp \
  "
```
